#include "Aq32FmSynth.h"
#include "imgui.h"

enum {
    EG_ATTACK = 0,
    EG_DECAY,
    EG_SUSTAIN,
    EG_RELEASE
};

static const uint16_t lut_logsin[256] = {
    0x859, 0x6c3, 0x607, 0x58b, 0x52e, 0x4e4, 0x4a6, 0x471,
    0x443, 0x41a, 0x3f5, 0x3d3, 0x3b5, 0x398, 0x37e, 0x365,
    0x34e, 0x339, 0x324, 0x311, 0x2ff, 0x2ed, 0x2dc, 0x2cd,
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    0x000, 0x000, 0x000, 0x000, 0x000, 0x000, 0x000, 0x000};

static const uint16_t lut_exp[256] = {
    0x3fa, 0x3f5, 0x3ef, 0x3ea, 0x3e4, 0x3df, 0x3da, 0x3d4,
    0x3cf, 0x3c9, 0x3c4, 0x3bf, 0x3b9, 0x3b4, 0x3ae, 0x3a9,
    0x3a4, 0x39f, 0x399, 0x394, 0x38f, 0x38a, 0x384, 0x37f,
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    0x014, 0x011, 0x00e, 0x00b, 0x008, 0x006, 0x003, 0x000};

static const uint8_t lut_pan_l[128] = {
    0x00, 0xff, 0xfe, 0xfe, 0xfe, 0xfe, 0xfe, 0xfe,
    0xfe, 0xfd, 0xfd, 0xfd, 0xfc, 0xfc, 0xfb, 0xfb,
    0xfa, 0xf9, 0xf9, 0xf8, 0xf7, 0xf7, 0xf6, 0xf5,
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    0x16, 0x13, 0x0f, 0x0c, 0x09, 0x06, 0x03, 0x00};

static const uint8_t lut_pan_r[128] = {
    0x00, 0x00, 0x03, 0x06, 0x09, 0x0c, 0x0f, 0x13,
    0x16, 0x19, 0x1c, 0x1f, 0x22, 0x26, 0x29, 0x2c,
    0x2f, 0x32, 0x35, 0x38, 0x3b, 0x3e, 0x41, 0x45,
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    0xfe, 0xfe, 0xfe, 0xfe, 0xfe, 0xfe, 0xfe, 0xff};

static const uint8_t mult_lut[16] = {1, 2, 4, 6, 8, 10, 12, 14, 16, 18, 20, 20, 24, 24, 30, 30};
static const uint8_t ksl_lut[16]  = {0, 32, 40, 45, 48, 51, 53, 55, 56, 58, 59, 60, 61, 62, 63, 64};

Aq32FmSynth::Aq32FmSynth() {
    reset();
}

void Aq32FmSynth::reset() {
    reg0_ch_4op = 0;
    reg1        = 0;
    reg2_kon    = 0;
    memset(ch_attr, 0, sizeof(ch_attr));
    memset(op_attr0, 0, sizeof(op_attr0));
    memset(op_attr1, 0, sizeof(op_attr1));
    memset(chData, 0, sizeof(chData));
    memset(opData, 0, sizeof(opData));
    timer  = 0;
    vibpos = 0;
    am_dir = false;
    am_cnt = 0;

    for (unsigned i = 0; i < 64; i++) {
        opData[i].eg_env   = 0x1FF;
        opData[i].eg_stage = EG_RELEASE;
    }
}

void Aq32FmSynth::render(int16_t results[2]) {
    bool dam = (reg1 >> 7) & 1;
    bool dvb = (reg1 >> 6) & 1;

    int accum_l   = 0;
    int accum_r   = 0;
    int op_result = 0;

    // AM / Vibrato
    timer = (timer + 1) & 0x3FF;
    if (timer == 0x3FF)
        vibpos = (vibpos + 1) & 7;
    if ((timer & 0x3F) == 0x3F) {
        am_cnt += am_dir ? 0xFF : 0x01;
        if (am_cnt == 105)
            am_dir = true;
        else if (am_cnt == 0)
            am_dir = false;
    }
    unsigned am_val = am_cnt >> (dam ? 2 : 4);

    for (unsigned op_sel = 0; op_sel < 64; op_sel++) {
        unsigned ws   = (op_attr1[op_sel] >> 0) & 7;
        bool     am   = (op_attr0[op_sel] >> 31) & 1;
        bool     vib  = (op_attr0[op_sel] >> 30) & 1;
        bool     sus  = (op_attr0[op_sel] >> 29) & 1;
        bool     ksr  = (op_attr0[op_sel] >> 28) & 1;
        unsigned mult = mult_lut[(op_attr0[op_sel] >> 24) & 0xF];
        unsigned ksl  = (op_attr0[op_sel] >> 22) & 3;
        unsigned tl   = (op_attr0[op_sel] >> 16) & 0x3F;
        unsigned ar   = (op_attr0[op_sel] >> 12) & 0xF;
        unsigned dr   = (op_attr0[op_sel] >> 8) & 0xF;
        unsigned sl   = (op_attr0[op_sel] >> 4) & 0xF;
        unsigned rr   = (op_attr0[op_sel] >> 0) & 0xF;
        OpData  &opd  = opData[op_sel];

        if (sl == 0xF)
            sl = 0x1F;

        unsigned pan     = (ch_attr[op_sel / 2] >> 20) & 127;
        unsigned fb      = (ch_attr[op_sel / 2] >> 17) & 7;
        bool     alg_2op = (ch_attr[op_sel / 2] >> 16) & 1;
        unsigned alg_4op = (((ch_attr[(op_sel / 4) * 2 + 0] >> 16) & 1) << 1) | ((ch_attr[(op_sel / 4) * 2 + 1] >> 16) & 1);
        unsigned block   = (ch_attr[op_sel / 2] >> 10) & 7;
        unsigned fnum    = (ch_attr[op_sel / 2] >> 0) & 0x3FF;
        bool     is_4op  = (reg0_ch_4op >> (op_sel / 4)) & 1;
        bool     kon     = (reg2_kon >> (op_sel / 2)) & 1;
        ChData  &chd     = chData[op_sel / 2];

        // Sample rate of audio is compatible with OPL (being 49722Hz),
        // but emulator has a sample rate of 44100Hz.
        // So we scale the frequency numbers here:
        fnum = (fnum * 49722) / 44100;
        if (fnum > 0x3FF) {
            fnum = 0x3FF;
        }

        bool do_fb;
        bool do_sum;
        bool do_mod;

        if (!is_4op) {
            do_fb  = (op_sel & 1) == 0;
            do_sum = (op_sel & 1) != 0 || alg_2op;
            do_mod = !alg_2op;

        } else {
            do_fb = (op_sel & 3) == 0;

            switch (alg_4op) {
                case 0: do_sum = (op_sel & 3) == 3; break;
                case 1: do_sum = (op_sel & 1) != 0; break;
                case 2: do_sum = !(((op_sel >> 1) & 1) ^ (op_sel & 1)); break;
                case 3: do_sum = (op_sel & 3) != 1; break;
            }
            switch (alg_4op) {
                case 0: do_mod = true; break;
                case 1: do_mod = (op_sel & 1) != 0; break;
                case 2: do_mod = (op_sel & 2) != 0; break;
                case 3: do_mod = (op_sel & 3) == 2; break;
            }
        }

        // EG
        unsigned env;
        bool     restart = false;
        {
            int eg_ksl = (ksl_lut[(fnum >> 6) & 0xF] << 2) - ((8 - block) << 5);
            if (eg_ksl < 0)
                eg_ksl = 0;

            switch (ksl) {
                case 0: eg_ksl >>= 8; break;
                case 1: eg_ksl >>= 1; break;
                case 2: eg_ksl >>= 2; break;
                case 3: eg_ksl >>= 0; break;
            }
            env = std::min(511U, opd.eg_env + (tl << 2) + eg_ksl + (am ? am_val : 0));

            // Rate offset (based on key split and key scaling)
            unsigned rof = ((block << 1) | ((fnum >> 9) & 1)) >> (ksr ? 0 : 2);

            // Stage rate
            unsigned stage_rate = 0;
            if (kon && opd.eg_stage == EG_RELEASE) {
                restart    = true;
                stage_rate = ar;

            } else {
                switch (opd.eg_stage) {
                    case EG_ATTACK: stage_rate = ar; break;
                    case EG_DECAY: stage_rate = dr; break;
                    case EG_SUSTAIN: stage_rate = sus ? 0 : rr; break;
                    case EG_RELEASE: stage_rate = rr; break;
                }
            }

            unsigned rate = std::min(63U, rof + (stage_rate << 2));

            uint8_t overflow = 0;
            if (stage_rate != 0) {
                unsigned eg_cnt = opd.eg_cnt + ((4 | (rate & 3)) << ((rate >> 2) & 0xF));
                overflow        = eg_cnt >> 15;
                opd.eg_cnt      = eg_cnt & 0x7FFF;
            }

            switch (opd.eg_stage) {
                case EG_ATTACK: {
                    if (opd.eg_env == 0)
                        opd.eg_stage = EG_DECAY;
                    else if (overflow > 0)
                        opd.eg_env -= ((opd.eg_env * overflow) >> 3) + 1;
                    break;
                }
                case EG_DECAY: {
                    if (((unsigned)(opd.eg_env >> 4)) >= sl) {
                        opd.eg_stage = EG_SUSTAIN;
                    } else {
                        opd.eg_env = std::min(511, opd.eg_env + overflow);
                    }
                    break;
                }
                case EG_SUSTAIN:
                case EG_RELEASE: {
                    opd.eg_env = std::min(511, opd.eg_env + overflow);
                    break;
                }
            }

            if (restart)
                opd.eg_stage = EG_ATTACK;
            if (!kon)
                opd.eg_stage = EG_RELEASE;
        }

        // Phase
        unsigned phase;
        {
            // Phase: Vibrato
            unsigned range = (fnum >> 7) & 7;
            if ((vibpos & 3) == 0 || !vib)
                range = 0;
            else if (vibpos & 1)
                range >>= 1;
            if (!dvb)
                range >>= 1;
            unsigned f_num = (vibpos & 4) ? (fnum - range) : (fnum + range);

            // Phase: Accumulator
            unsigned phase_inc = (((f_num << block) >> 1) * mult) >> 1;
            phase              = opd.phase >> 9;
            opd.phase          = (restart ? 0 : opd.phase) + phase_inc;
        }

        // Feedback
        int fbmod = (fb == 0) ? 0 : (((chd.prevSamples[0] + chd.prevSamples[1]) / 4) >> (fb ^ 7));

        // Operator
        {
            unsigned op_modulation = 0;
            if (do_fb)
                op_modulation = fbmod;
            else if (do_mod)
                op_modulation = op_result;

            unsigned op_phase = (phase + op_modulation) & 0x3FF;

            uint8_t logsin_idx;
            switch (ws) {
                default: logsin_idx = ((op_phase & 0x100) ? ~op_phase : op_phase) & 0xFF; break;
                case 4:
                case 5: logsin_idx = (((op_phase & 0x100) ? ~op_phase : op_phase) << 1) & 0xFF; break;
            }
            unsigned logsin_value = lut_logsin[logsin_idx];

            bool negate;
            switch (ws) {
                default: negate = false; break;
                case 0:
                case 6:
                case 7: negate = (op_phase & 0x200) != 0; break;
                case 4: negate = (op_phase & 0x300) == 0x100; break;
            }

            unsigned out;
            switch (ws) {
                default: out = logsin_value; break;
                case 1:
                case 4:
                case 5: out = (op_phase & 0x200) ? 0x1000 : logsin_value; break;
                case 3: out = (op_phase & 0x100) ? 0x1000 : logsin_value; break;
                case 6: out = 0; break;
                case 7: out = ((op_phase & 0x1FF) ^ ((op_phase & 0x200) ? 0x1FF : 0)) << 3; break;
            }

            unsigned level = std::min(0x1FFFU, out + (env << 3));
            op_result      = ((0x400 | lut_exp[level & 0xFF]) << 1) >> (level >> 8);
            if (op_result != 0 && negate)
                op_result = ~op_result;

            if (do_sum) {
                accum_l += (op_result * lut_pan_l[pan]) >> 8;
                accum_r += (op_result * lut_pan_r[pan]) >> 8;
            }

            if ((op_sel & 1) == 0) {
                chd.prevSamples[1] = chd.prevSamples[0];
                chd.prevSamples[0] = op_result;
            }
        }
    }

    results[0] = std::min(std::max(-32768, accum_l), 32767);
    results[1] = std::min(std::max(-32768, accum_r), 32767);
}

void Aq32FmSynth::dbgDrawIoRegs() {
    ImGui::Text("reg0_ch_4op: 0x%04X", reg0_ch_4op);
    ImGui::Text("reg1: 0x%04X", reg1);
    ImGui::Text("reg2_kon: 0x%08X", reg2_kon);
}
