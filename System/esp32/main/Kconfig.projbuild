## System/esp32/main/Kconfig.projbuild
```kconfig
menu "* Firmware settings *"
    choice
        prompt "Machine type"
        default MACHINE_TYPE_AQPLUS
        config MACHINE_TYPE_AQPLUS
            bool "Aquarius+"
    endchoice

    config UARTPROTOCOL_BAUDRATE
        int "UART protocol baudrate"
        default 3579545

    config FPGA_SPI_SPEED_HZ
        int "FPGA SPI speed in Hz"
        default 1000000

    config GITHUB_BASE_URL
        string "GitHub base URL"
        default "https://github.com/fvdhoef/aquarius-plus"
        help
            Base URL of GitHub project.
    
    config UPDATE_FILE_NAME
        string "Update file name"
        default "aquarius-plus.bin"
        help
            Name of update file. Assumed to be the same for GitHub and SD card update.

    config BYPASS_START_TIME_MS
        int "Bypass start screen time (ms)"
        default 3000
        help
            Time to wait after reset before sending an 'Enter' key press to bypass the Aquarius start screen.

endmenu
```

## esp32/sdkconfig.defaults
```kconfig
CONFIG_ESPTOOLPY_FLASHMODE_QIO=y
CONFIG_ESPTOOLPY_FLASHSIZE_4MB=y
CONFIG_PARTITION_TABLE_CUSTOM=y
CONFIG_COMPILER_OPTIMIZATION_SIZE=y
# CONFIG_ETH_USE_SPI_ETHERNET is not set
CONFIG_SPIRAM=y
CONFIG_SPIRAM_IGNORE_NOTFOUND=y
CONFIG_SPIRAM_TRY_ALLOCATE_WIFI_LWIP=y
CONFIG_ESP32_WIFI_STATIC_RX_BUFFER_NUM=10
CONFIG_ESP32_WIFI_RX_BA_WIN=6
# CONFIG_ESP_WIFI_STA_DISCONNECTED_PM_ENABLE is not set
CONFIG_FATFS_LFN_HEAP=y
CONFIG_LWIP_LOCAL_HOSTNAME="aqplus"
# CONFIG_MQTT_PROTOCOL_311 is not set
# CONFIG_MQTT_TRANSPORT_SSL is not set
# CONFIG_MQTT_TRANSPORT_WEBSOCKET is not set
```
